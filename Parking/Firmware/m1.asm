PROCESSOR 16F877A
INCLUDE "P16F877A.INC"
__CONFIG _DEBUG_OFF&_CP_OFF&_WRT_HALF&_CPD_OFF&_LVP_OFF&_BODEN_OFF&_PWRTE_OFF&_WDT_OFF&_XT_OSC

COUNTER EQU 0X20
FLOORG	EQU 0X21
FLOORB	EQU 0X22
COUNT1	EQU 0X23


ORG 0X000
	GOTO MAIN

ORG 0X004
	BTFSS PIR1,TMR1IF
	GOTO EXIT_INTERRUPT
	INCF COUNT1
	MOVF COUNT1,W
	SUBLW .30
	BTFSS STATUS,Z ;CHECK ZERO STATE
	GOTO EXIT_INTERRUPT
	CLRF COUNT1
	BCF PORTC,1 ;TURN OFF FLOOR B LIGHTS
	BCF T1CON,TMR1ON
EXIT_INTERRUPT
	BCF PIR1,TMR1IF ;CLEAR TIMER1 INTERRUPT FLAG
	RETFIE




MAIN
	BANKSEL TRISA
	MOVLW 0X01
	MOVWF TRISA ;PIN RA0 IS INPUT FOR ANALOG LDR SIGNAL
	MOVLW 0X0F
	MOVWF TRISB
	CLRF TRISD
	CLRF TRISE
	MOVLW .125 ;125 BAUD PER SECOND
	MOVWF SPBRG
	MOVLW 0X20
	MOVWF TXSTA
	MOVLW 2
	MOVWF ADCON1 ;ADC RESULT LEFT JUSTIFIED 

	BANKSEL PORTC
	CLRF PORTC
	CLRF FLOORG
	CLRF FLOORB
	MOVLW 0X30
	MOVWF T1CON ;PREPARE TIMER1 TO COUNT TO GET 60 SECONDS WHEN IT OCCURES 30 TIMES (EACH TIME IS 2 SECONDS APROXIMATELY) 1:8 PRESCALER
	MOVLW 0X90
	MOVWF RCSTA ;START SERIAL PORT
	
	BANKSEL TRISC
	MOVLW 0X80
	MOVWF TRISC
	BSF PIE1,TMR1IE ;ENABLE TIMER1 INTERRUPT
	BANKSEL PORTC
	
	;ENABLE INTERRUPT FOR TIMER1
	BSF INTCON,PEIE
	BSF INTCON,GIE

LOOP
	;CONTROL FLOOR G LIGHTS
	;READ ADC0
	CALL ADC_READ
	SUBLW 0X80 ;THRESHOLD VALUE
	BTFSC STATUS,C ;CHECK BORROW STATE (INVERED)
	GOTO CLEAR_LIGHT
	BSF PORTC,0
	GOTO CHECK_BUTTON0
CLEAR_LIGHT
	BCF PORTC,0
CHECK_BUTTON0
	BTFSC PORTB,0
	GOTO CHECK_BUTTON1
	;G IN PRESSED
CHECK0
	BTFSS PORTB,0
	GOTO CHECK0 ;WAIT UNTIL BUTTON RELEASED
	INCF FLOORG
	CALL SEND
CHECK_BUTTON1
	BTFSC PORTB,1
	GOTO CHECK_BUTTON2
	;G OUT PRESSED
CHECK1
	BTFSS PORTB,1
	GOTO CHECK1 ;WAIT UNTIL BUTTON RELEASED
	DECF FLOORG
	CALL SEND
CHECK_BUTTON2
	BTFSC PORTB,2
	GOTO CHECK_BUTTON3
	;B IN PRESSED
CHECK2
	BTFSS PORTB,2
	GOTO CHECK2 ;WAIT UNTIL BUTTON RELEASED
	BSF PORTC,1 ;FLOORB LIGHTS
	BSF T1CON,TMR1ON ;TURN ON TIMER1
	INCF FLOORB
	CALL SEND
CHECK_BUTTON3
	BTFSC PORTB,3
	GOTO LOOP
	;B OUT PRESSED
CHECK3
	BTFSS PORTB,3
	GOTO CHECK3 ;WAIT UNTIL BUTTON RELEASED
	DECF FLOORB
	CALL SEND
	GOTO LOOP


DELAY
	CLRF COUNTER
DELAY_LOOP
	DECFSZ COUNTER
	GOTO DELAY_LOOP
	RETURN
	
	
ADC_READ
	MOVLW 0XC1
  	MOVWF ADCON0			;CLOCK is internal rc,A/D enabled
	CALL DELAY				;Wait to charge the internal capacitor
	BSF ADCON0,GO			;Start ADC Conversion
ADC_LOOP
	BTFSC ADCON0,GO			;Test if ADC conversion finished?
	GOTO ADC_LOOP
	MOVF ADRESH,W
	RETURN
	
SEND
	MOVF FLOORG,W
	SUBLW .15 ;CHECK IF IT IS GREATER THEN 15
	BTFSC STATUS,C
	GOTO SENDB1
	MOVLW .15
	MOVWF FLOORG
SENDB1
	MOVF FLOORG,W
	MOVWF TXREG
	CALL DELAY
	MOVF FLOORB,W
	SUBLW .15 ;CHECK IF IT IS GREATER THEN 15
	BTFSC STATUS,C
	GOTO SENDB2
	MOVLW .15
	MOVWF FLOORB
SENDB2
	MOVF FLOORB,W
	MOVWF TXREG
	CALL DELAY
	RETURN

END