PROCESSOR 16F877A
INCLUDE "P16F877A.INC"
__CONFIG _DEBUG_OFF&_CP_OFF&_WRT_HALF&_CPD_OFF&_LVP_OFF&_BODEN_OFF&_PWRTE_OFF&_WDT_OFF&_XT_OSC

COUNTER	EQU	0X20
FLOORG	EQU	0X21
FLOORB	EQU	0X22
DIG1	EQU	0X23
DIG2	EQU	0X24
DIG3	EQU	0X25
DIG4	EQU	0X26
UARTP	EQU 0X27

DIV		EQU 30H
MOD		EQU 31H
VAL		EQU 32H
OPER	EQU 33H
VAL1	EQU 34H

BLINKG	EQU 40H
BLINKB	EQU 41H
BLINKV	EQU 42H
BCOUNT	EQU 43H


ORG 0X000
	GOTO MAIN



;	BTFSS PIR1,RCIF
;	GOTO EXIT_INTERRUPT
;	MOVF RCREG,W ;RCIF FLAG CLEARED
;	MOVWF TXREG
;	MOVWF FLOORG
;EXIT_INTERRUPT	
;	RETFIE

ORG 0X004
	BTFSS PIR1,RCIF
	GOTO EXIT_INTERRUPT
	MOVF UARTP,W
	MOVWF FSR
	MOVF RCREG,W
	MOVWF INDF
	INCF UARTP,F
	MOVF UARTP,W
	SUBLW 0X23
	BTFSS STATUS,Z
	GOTO EXIT_INTERRUPT
	MOVLW 0X21
	MOVWF UARTP
EXIT_INTERRUPT	
	RETFIE

MAIN
	BANKSEL TRISA
	CLRF TRISA
	CLRF TRISB
	MOVLW 0X80 ;PIN RC7 IS INPUT FOR USART
	MOVWF TRISC
	CLRF TRISD
	CLRF TRISE
	MOVLW .125 ;125 BAUD PER SECOND
	MOVWF SPBRG
	;MOVLW 0X20
	;MOVWF TXSTA
	BSF PIE1,RCIE ;ENABLE UART INTERRUPT

	BANKSEL PORTC
	MOVLW 0X0F
	MOVWF PORTC
	MOVLW 0X90
	MOVWF RCSTA
	CLRF FLOORG
	CLRF FLOORB
	CLRF DIG1
	CLRF DIG2
	CLRF DIG3
	CLRF DIG4
	CLRF BLINKG
	CLRF BLINKB
	CLRF BLINKV
	CLRF BCOUNT
	MOVLW 0X21
	MOVWF UARTP
	
	BSF INTCON,PEIE ;ENABLE PEREPHIRALS INTERRUPTS
	BSF INTCON,GIE ;ENABLE INTERRUPT GLOBALLY

LOOP
	INCF BCOUNT
	MOVLW .35 ;BLINK DURATION
	SUBWF BCOUNT,W
	BTFSS STATUS,Z
	GOTO ANALYZEG
	CLRF BCOUNT
	MOVLW 1
	XORWF BLINKV ;CHANGE BLINK VALUE (0,1)
ANALYZEG
	;ANALYZE FLOORG
	MOVF FLOORG,W
	ANDLW 0X0F  ;GET LS NIBBLE
	MOVWF VAL
	SUBLW 0X0F ;IF W=15 THEN BLINK
	BTFSC STATUS,Z
	GOTO SETBLINKG
	CLRF BLINKG
	GOTO CALCG
SETBLINKG
	MOVLW 1
	MOVWF BLINKG
CALCG
	MOVLW 0X0A
	MOVWF OPER
	CALL DIVIDE
	MOVF DIV,W
	MOVWF DIG1
	MOVF MOD,W
	MOVWF DIG2
	MOVF BLINKG,F ;UPDATE STATUS REGISTER
	BTFSC STATUS,Z
	GOTO ANALYZEB
	MOVF BLINKV,F ;UPDATE STATUS REGISTER
	BTFSC STATUS,Z
	GOTO ANALYZEB
	MOVLW .10
	MOVWF DIG1
	MOVWF DIG2

ANALYZEB	
	;ANALYZE FLOORB
	MOVF FLOORB,W
	ANDLW 0X0F  ;GET LS NIBBLE
	MOVWF VAL
	SUBLW 0X0F ;IF W=15 THEN BLINK
	BTFSC STATUS,Z
	GOTO SETBLINKB
	CLRF BLINKB
	GOTO CALCB
SETBLINKB
	MOVLW 1
	MOVWF BLINKB
CALCB
	MOVLW 0X0A
	MOVWF OPER
	CALL DIVIDE
	MOVF DIV,W
	MOVWF DIG3
	MOVF MOD,W
	MOVWF DIG4
	MOVF BLINKB,F ;UPDATE STATUS REGISTER
	BTFSC STATUS,Z
	GOTO DISPALY
	MOVF BLINKV,F ;UPDATE STATUS REGISTER
	BTFSC STATUS,Z
	GOTO DISPALY
	MOVLW .10
	MOVWF DIG3
	MOVWF DIG4
DISPALY
	;DISPLAY DIGITS
	BCF PORTD,3
	MOVF DIG1,W
	CALL GETDIGITVALUE
	MOVWF PORTB
	BSF PORTD,0
	CALL DELAY
	BCF PORTD,0
	MOVF DIG2,W
	CALL GETDIGITVALUE
	MOVWF PORTB
	BSF PORTD,1
	CALL DELAY
	BCF PORTD,1
	MOVF DIG3,W
	CALL GETDIGITVALUE
	MOVWF PORTB
	BSF PORTD,2
	CALL DELAY
	BCF PORTD,2
	MOVF DIG4,W
	CALL GETDIGITVALUE
	MOVWF PORTB
	BSF PORTD,3
	CALL DELAY
	GOTO LOOP
	
DELAY
	CLRF COUNTER
DELAY_LOOP
	DECFSZ COUNTER
	GOTO DELAY_LOOP
	RETURN

GETDIGITVALUE
	ADDWF PCL
	RETLW 0XC0
	RETLW 0XF9
	RETLW 0XA4
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	RETLW 0XFF

DIVIDE
	CLRF DIV
	CLRF MOD
CHECK_AGAIN
	MOVF VAL,W
	MOVWF VAL1
	MOVF OPER,W
	SUBWF VAL1,F
	BTFSS STATUS,C		;IT'S BORROW (INVERSED)
	GOTO SET_VALUES
	MOVF OPER,W
	SUBWF VAL,F
	INCF DIV,F
	GOTO CHECK_AGAIN
SET_VALUES
	MOVF VAL,W
	MOVWF MOD
	RETURN


END